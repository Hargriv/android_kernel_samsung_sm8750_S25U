## fs/poaceaefs/Kconfig
```kconfig
config POACEAE_FS
    tristate "PoaceaeFS: Stackable Stealth Filesystem"
    default n
    help
      PoaceaeFS is a stackable stealth filesystem designed for 
      hiding files, redirecting paths, and spoofing attributes.
      
      It is typically used for advanced root hiding or security research.

      If unsure, say N.
```
